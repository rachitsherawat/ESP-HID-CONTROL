## firmware/sdkconfig.defaults
```kconfig
# Set Target
CONFIG_IDF_TARGET="esp32c6"

# Enable Bluetooth and NimBLE
CONFIG_BT_ENABLED=y
CONFIG_BT_NIMBLE_ENABLED=y

# NimBLE HID settings
CONFIG_BT_NIMBLE_MAX_CONNECTIONS=1
CONFIG_BT_NIMBLE_MAX_BONDS=3
CONFIG_BT_NIMBLE_MAX_SERVICES=10

# WiFi Settings
CONFIG_ESP_WIFI_AUTH_WPA2_PSK=y

# HTTP Server settings
CONFIG_HTTPD_MAX_REQ_HDR_LEN=1024
CONFIG_HTTPD_MAX_URI_LEN=1024
CONFIG_HTTPD_WS_SUPPORT=y

# C++ support for some components if needed
CONFIG_COMPILER_CXX_EXCEPTIONS=y
```
